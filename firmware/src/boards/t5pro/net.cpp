// hal::Net for the T5 E-Paper S3 Pro: Wi-Fi STA with credentials in NVS (namespace "qnet"), the
// captive-portal provisioner (hotspot "QuireOS-Setup" with a scan list), blocking HTTP(S) through
// HTTPClient + WiFiClientSecure with the embedded Mozilla CA bundle, SNTP into the RTC, ArduinoOTA +
// mDNS ("quireos.local") and the LAN web server (web_server.cpp), all started once Wi-Fi connects.
#include <Arduino.h>
#include <ArduinoOTA.h>
#include <DNSServer.h>
#include <ESPmDNS.h>
#include <HTTPClient.h>
#include <Preferences.h>
#include <WebServer.h>
#include <WiFi.h>
#include <WiFiClientSecure.h>
#include <esp_sntp.h>
#include <string.h>
#include <strings.h>
#include <time.h>

#include "board_t5pro.h"
#include "pins.h"

// Generated by certs/gen_crt_bundle.py and embedded via board_build.embed_files; the symbol name
// is derived from the path given in platformio.ini.
extern const uint8_t x509_crt_bundle_start[] asm("_binary_src_boards_t5pro_certs_x509_crt_bundle_bin_start");

namespace quire {
namespace t5pro {
namespace {

const char *const TAG = "net";
const char *const NVS_NS = "qnet";
const char *const AP_SSID = "QuireOS-Setup";
const char *const HOSTNAME = "quireos";
const char *const USER_AGENT = "QuireOS/" QUIREOS_VERSION " (t5pro)";

volatile bool g_sntp_synced = false;
void on_sntp_sync(struct timeval *) { g_sntp_synced = true; }

// HTTPClient::writeToStream() unwraps chunked transfer-encoding but pushes; collect the body into
// one PSRAM buffer with a hard cap.
class Sink : public Stream {
 public:
  explicit Sink(size_t cap) : cap_(cap) {
    buf_ = (uint8_t *)hal::alloc_big(cap + 1);
    if (buf_) buf_[0] = 0;
  }
  ~Sink() {
    if (buf_) hal::free_big(buf_);
  }
  bool ok() const { return buf_ != nullptr; }
  int available() override { return 0; }
  int read() override { return -1; }
  int peek() override { return -1; }
  void flush() override {}
  size_t write(uint8_t b) override { return write(&b, 1); }
  size_t write(const uint8_t *d, size_t n) override {
    if (!buf_ || len_ + n > cap_) {
      overflow_ = true;
      return 0;
    }
    memcpy(buf_ + len_, d, n);
    len_ += n;
    buf_[len_] = 0;
    return n;
  }
  uint8_t *release() {
    uint8_t *b = buf_;
    buf_ = nullptr;
    return b;
  }
  size_t size() const { return len_; }
  bool overflowed() const { return overflow_; }

 private:
  uint8_t *buf_;
  size_t cap_, len_ = 0;
  bool overflow_ = false;
};

bool ip_private(IPAddress ip) {
  uint8_t a = ip[0], b = ip[1];
  return a == 10 || (a == 172 && b >= 16 && b <= 31) || (a == 192 && b == 168) || (a == 169 && b == 254) || a == 127;
}

bool host_from_url(const char *url, char *host, size_t len) {
  const char *p = strstr(url, "://");
  if (!p) return false;
  p += 3;
  const char *e = p;
  while (*e && *e != '/' && *e != ':' && *e != '?' && *e != '#') e++;
  size_t n = (size_t)(e - p);
  if (n == 0 || n >= len) return false;
  memcpy(host, p, n);
  host[n] = 0;
  return true;
}

// Plain http:// only to the LAN: .local names, private IPv4 literals, or names resolving to them.
bool plain_http_allowed(const char *url) {
  char host[128];
  if (!host_from_url(url, host, sizeof(host))) return false;
  size_t n = strlen(host);
  if (n > 6 && strcasecmp(host + n - 6, ".local") == 0) return true;
  IPAddress ip;
  if (ip.fromString(host)) return ip_private(ip);
  if (WiFi.hostByName(host, ip) == 1) return ip_private(ip);
  return false;
}

String html_escape(const String &in) {
  String o;
  o.reserve(in.length() + 8);
  for (size_t i = 0; i < in.length(); i++) {
    char c = in[i];
    if (c == '&') o += "&amp;";
    else if (c == '<') o += "&lt;";
    else if (c == '>') o += "&gt;";
    else if (c == '"') o += "&quot;";
    else o += c;
  }
  return o;
}

String scan_options() {
  int n = WiFi.scanNetworks(false, false);
  String opts;
  for (int i = 0; i < n && i < 30; i++) {
    String s = WiFi.SSID(i);
    if (s.length() == 0) continue;
    opts += "<option value=\"" + html_escape(s) + "\">" + html_escape(s) + "  (" + WiFi.RSSI(i) + " dBm)</option>";
  }
  if (opts.length() == 0) opts = "<option value=\"\">(no networks found)</option>";
  WiFi.scanDelete();
  return opts;
}

String portal_page(const String &options) {
  return "<!doctype html><html><head><meta name=viewport content=\"width=device-width,initial-scale=1\">"
         "<title>QuireOS setup</title><style>"
         "body{font:16px -apple-system,system-ui,sans-serif;margin:0;padding:24px;background:#f4f4f0;color:#111}"
         "h1{font-size:20px;margin:0 0 4px}p.s{color:#666;margin:0 0 20px;font-size:14px}"
         "label{display:block;margin:14px 0 4px;font-weight:600}"
         "select,input{width:100%;padding:11px;font-size:16px;border:1px solid #bbb;border-radius:6px;box-sizing:border-box}"
         "button{margin-top:20px;width:100%;padding:13px;font-size:16px;background:#111;color:#fff;"
         "border:0;border-radius:6px;font-weight:600}a{color:#666;font-size:13px}"
         "</style></head><body><h1>QuireOS</h1>"
         "<p class=s>Connect this device to Wi-Fi.</p>"
         "<form method=POST action=/save>"
         "<label>Network</label><select name=ssid>" + options + "</select>"
         "<label>Password</label><input type=password name=pass autocomplete=off placeholder=\"leave blank if open\">"
         "<button type=submit>Save</button></form>"
         "<p style=\"margin-top:18px\"><a href=/rescan>Rescan networks</a></p>"
         "</body></html>";
}

class T5Net : public hal::Net {
 public:
  bool begin() override {
    ensure_prefs();
    WiFi.persistent(false);
    WiFi.setAutoReconnect(true);
    return true;
  }

  bool connected() override { return WiFi.status() == WL_CONNECTED; }
  int rssi() override { return connected() ? WiFi.RSSI() : 0; }
  const char *ssid() override { return ssid_; }

  const char *ip() override {
    if (connected()) strlcpy(ip_, WiFi.localIP().toString().c_str(), sizeof(ip_));
    else ip_[0] = 0;
    return ip_;
  }

  bool has_credentials() override {
    ensure_prefs();
    return ssid_[0] != 0;
  }

  bool connect(uint32_t timeout_ms) override {
    ensure_prefs();
    if (!ssid_[0]) return false;
    if (connected()) {
      start_services();
      return true;
    }
    WiFi.persistent(false);
    WiFi.mode(WIFI_STA);
    WiFi.setHostname(HOSTNAME);
    WiFi.setSleep(true);
    WiFi.begin(ssid_, pass_);
    uint32_t t0 = ::millis();
    while (WiFi.status() != WL_CONNECTED && ::millis() - t0 < timeout_ms) ::delay(100);
    bool ok = connected();
    hal::log(ok ? hal::LOG_INFO : hal::LOG_WARN, TAG, "wifi %s (%s) in %lu ms%s%s", ok ? "connected" : "failed", ssid_,
             (unsigned long)(::millis() - t0), ok ? ", ip " : "", ok ? ip() : "");
    if (ok) start_services();
    return ok;
  }

  void forget() override {
    ensure_prefs();
    prefs_.remove("ssid");
    prefs_.remove("pass");
    ssid_[0] = pass_[0] = 0;
    WiFi.disconnect(true, true);
    hal::log(hal::LOG_INFO, TAG, "wifi credentials forgotten");
  }

  // Blocking captive portal. Returns when credentials were saved, or when BOOT is held for 3 s to
  // keep whatever is stored. Drawing the on-screen instructions is the OS's job.
  void provision() override {
    ensure_prefs();
    web_server_stop();
    WiFi.persistent(false);
    WiFi.disconnect(true, false);
    WiFi.mode(WIFI_AP_STA);
    String options = scan_options();
    WiFi.softAP(AP_SSID);
    ::delay(400);
    IPAddress ip = WiFi.softAPIP();
    hal::log(hal::LOG_INFO, TAG, "portal '%s' at %s", AP_SSID, ip.toString().c_str());

    DNSServer dns;
    dns.setErrorReplyCode(DNSReplyCode::NoError);
    dns.start(53, "*", ip);

    WebServer srv(80);
    bool saved = false;
    String new_ssid, new_pass;
    srv.on("/", [&] { srv.send(200, "text/html", portal_page(options)); });
    srv.on("/save", HTTP_POST, [&] {
      new_ssid = srv.arg("ssid");
      new_pass = srv.arg("pass");
      if (new_ssid.length() == 0 || new_ssid.length() > 32 || new_pass.length() > 63) {
        srv.sendHeader("Location", "/");
        srv.send(302, "text/plain", "");
        return;
      }
      saved = true;
      srv.send(200, "text/html",
               "<!doctype html><meta name=viewport content=\"width=device-width,initial-scale=1\">"
               "<body style=\"font:16px system-ui;padding:24px;background:#f4f4f0\"><h2>Saved</h2>"
               "<p>QuireOS is connecting to <b>" + html_escape(new_ssid) + "</b>. You can close this page.</p></body>");
    });
    srv.on("/rescan", [&] {
      options = scan_options();
      srv.sendHeader("Location", "/");
      srv.send(302, "text/plain", "");
    });
    srv.onNotFound([&] {   // captive-portal probes from iOS / Android / Windows
      srv.sendHeader("Location", String("http://") + WiFi.softAPIP().toString() + "/");
      srv.send(302, "text/plain", "");
    });
    srv.begin();

    pinMode(T5PRO_BOOT_BUTTON, INPUT_PULLUP);
    uint32_t held = 0, t_saved = 0;
    while (true) {
      dns.processNextRequest();
      srv.handleClient();
      uint32_t now = ::millis();
      if (saved) {
        if (!t_saved) t_saved = now;
        else if (now - t_saved > 800) break;   // let the reply reach the browser
      }
      if (digitalRead(T5PRO_BOOT_BUTTON) == LOW) {
        if (!held) held = now;
        else if (now - held > 3000) break;
      } else {
        held = 0;
      }
      ::delay(2);
    }
    srv.stop();
    dns.stop();
    WiFi.softAPdisconnect(true);
    WiFi.mode(WIFI_STA);
    if (saved) {
      save_creds(new_ssid.c_str(), new_pass.c_str());
      hal::log(hal::LOG_INFO, TAG, "credentials saved for '%s'", ssid_);
    } else {
      hal::log(hal::LOG_INFO, TAG, "portal skipped");
    }
  }

  bool http(const hal::HttpRequest &req, hal::HttpResponse &out) override {
    out = hal::HttpResponse();
    uint32_t t0 = ::millis();
    auto fail = [&](int err) {
      out.error = err;
      out.elapsed_ms = ::millis() - t0;
      return false;
    };
    if (!req.url || !req.method) return fail(hal::HTTP_ERR_PROTOCOL);
    bool https = strncasecmp(req.url, "https://", 8) == 0;
    bool plain = strncasecmp(req.url, "http://", 7) == 0;
    if (!https && !plain) return fail(hal::HTTP_ERR_PROTOCOL);
    if (!connected()) return fail(hal::HTTP_ERR_OFFLINE);
    if (plain && !plain_http_allowed(req.url)) {
      hal::log(hal::LOG_WARN, TAG, "refused plain http to non-LAN host: %s", req.url);
      return fail(hal::HTTP_ERR_REFUSED);
    }

    uint32_t to_s = (req.timeout_ms + 999) / 1000;
    if (to_s < 1) to_s = 1;
    WiFiClientSecure secure;
    WiFiClient insecure;
    if (https) {
      secure.setCACertBundle(x509_crt_bundle_start);
      secure.setHandshakeTimeout(to_s);
      secure.setTimeout(to_s);
    } else {
      insecure.setTimeout(to_s);
    }

    HTTPClient h;
    h.setReuse(false);
    h.setFollowRedirects(HTTPC_DISABLE_FOLLOW_REDIRECTS);
    h.setConnectTimeout((int32_t)req.timeout_ms);
    h.setTimeout((uint16_t)(req.timeout_ms > 65535 ? 65535 : req.timeout_ms));
    h.setUserAgent(USER_AGENT);
    WiFiClient &client = https ? static_cast<WiFiClient &>(secure) : insecure;
    if (!h.begin(client, String(req.url))) return fail(hal::HTTP_ERR_PROTOCOL);
    static const char *collect[] = {"ETag", "Content-Type"};
    h.collectHeaders(collect, 2);

    // HTTPClient writes Host, Connection, Content-Length, Accept-Encoding (identity) and User-Agent
    // itself; route those through its own setters or drop them so nothing is sent twice.
    for (size_t i = 0; i < req.header_count; i++) {
      const char *hd = req.headers ? req.headers[i] : nullptr;
      if (!hd) continue;
      const char *colon = strchr(hd, ':');
      if (!colon) continue;
      char name[64];
      size_t nl = (size_t)(colon - hd);
      if (nl == 0 || nl >= sizeof(name)) continue;
      memcpy(name, hd, nl);
      name[nl] = 0;
      const char *value = colon + 1;
      while (*value == ' ' || *value == '\t') value++;
      if (strcasecmp(name, "User-Agent") == 0) h.setUserAgent(value);
      else if (strcasecmp(name, "Host") == 0 || strcasecmp(name, "Connection") == 0 ||
               strcasecmp(name, "Content-Length") == 0 || strcasecmp(name, "Accept-Encoding") == 0)
        continue;
      else h.addHeader(name, value);
    }

    int code = h.sendRequest(req.method, (uint8_t *)req.body, req.body_len);
    if (code < 0) {
      int err = hal::HTTP_ERR_CONNECT;
      if (code == HTTPC_ERROR_READ_TIMEOUT) err = hal::HTTP_ERR_TIMEOUT;
      else if (code == HTTPC_ERROR_NO_HTTP_SERVER || code == HTTPC_ERROR_ENCODING) err = hal::HTTP_ERR_PROTOCOL;
      else if (code == HTTPC_ERROR_CONNECTION_REFUSED && https) {
        char eb[80] = {0};
        int le = secure.lastError(eb, sizeof(eb));
        if (le != 0 && le != -1) {
          err = hal::HTTP_ERR_TLS;
          hal::log(hal::LOG_WARN, TAG, "tls %s: %d %s", req.url, le, eb);
        }
      }
      hal::log(hal::LOG_WARN, TAG, "%s %s failed: %s (%d)", req.method, req.url, HTTPClient::errorToString(code).c_str(), code);
      h.end();
      return fail(err);
    }
    out.status = code;
    strlcpy(out.etag, h.header("ETag").c_str(), sizeof(out.etag));
    strlcpy(out.content_type, h.header("Content-Type").c_str(), sizeof(out.content_type));

    int size = h.getSize();   // -1 when unknown (chunked or connection-close)
    if (size > 0 && (size_t)size > req.max_bytes) {
      h.end();
      return fail(hal::HTTP_ERR_TOO_BIG);
    }
    Sink sink(size > 0 ? (size_t)size : req.max_bytes);
    if (!sink.ok()) {
      h.end();
      return fail(hal::HTTP_ERR_TOO_BIG);
    }
    bool no_body = strcasecmp(req.method, "HEAD") == 0 || code == 204 || code == 304 || (code >= 100 && code < 200);
    if (!no_body && size != 0) {
      int r = h.writeToStream(&sink);
      if (sink.overflowed()) {
        h.end();
        return fail(hal::HTTP_ERR_TOO_BIG);
      }
      if (r < 0 && !(r == HTTPC_ERROR_NOT_CONNECTED && size < 0)) {   // already closed with an empty body is fine
        hal::log(hal::LOG_WARN, TAG, "%s %s body: %s (%d)", req.method, req.url, HTTPClient::errorToString(r).c_str(), r);
        h.end();
        return fail(r == HTTPC_ERROR_READ_TIMEOUT ? hal::HTTP_ERR_TIMEOUT : hal::HTTP_ERR_CONNECT);
      }
    }
    h.end();
    out.len = sink.size();
    out.body = sink.release();
    out.error = hal::HTTP_OK;
    out.elapsed_ms = ::millis() - t0;
    hal::log(hal::LOG_DEBUG, TAG, "%s %s -> %d, %u bytes, %lu ms", req.method, req.url, code, (unsigned)out.len,
             (unsigned long)out.elapsed_ms);
    return true;
  }

  void http_free(uint8_t *body) override { hal::free_big(body); }

  void poll() override {
    if (services_) {
      ArduinoOTA.handle();
      web_server_poll();
    }
    if (g_sntp_synced) {
      g_sntp_synced = false;
      hal::Clock *c = hal::board().clock;
      if (c) c->set((int64_t)time(nullptr));
      hal::log(hal::LOG_INFO, TAG, "sntp synced");
    }
  }

 private:
  void ensure_prefs() {
    if (prefs_ok_) return;
    prefs_ok_ = prefs_.begin(NVS_NS, false);
    if (!prefs_ok_) return;
    prefs_.getString("ssid", ssid_, sizeof(ssid_));
    prefs_.getString("pass", pass_, sizeof(pass_));
  }

  void save_creds(const char *s, const char *p) {
    ensure_prefs();
    strlcpy(ssid_, s, sizeof(ssid_));
    strlcpy(pass_, p, sizeof(pass_));
    prefs_.putString("ssid", ssid_);
    prefs_.putString("pass", pass_);
  }

  void start_services() {
    if (services_) return;
    services_ = true;
    sntp_set_time_sync_notification_cb(on_sntp_sync);
    configTime(0, 0, "pool.ntp.org", "time.nist.gov");
    ArduinoOTA.setHostname(HOSTNAME);
    ArduinoOTA.setMdnsEnabled(true);
    ArduinoOTA.setRebootOnSuccess(true);
    ArduinoOTA.onStart([] {
      hal::log(hal::LOG_INFO, "ota", "update starting");
      display_save_glass();
    });
    ArduinoOTA.onError([](ota_error_t e) { hal::log(hal::LOG_ERROR, "ota", "error %d", (int)e); });
    ArduinoOTA.begin();   // also starts mDNS as quireos.local
    MDNS.addService("http", "tcp", 80);
    web_server_start();
    hal::log(hal::LOG_INFO, TAG, "services up: sntp, ota, mdns %s.local, http :80", HOSTNAME);
  }

  Preferences prefs_;
  bool prefs_ok_ = false;
  bool services_ = false;
  char ssid_[33] = {0}, pass_[65] = {0}, ip_[16] = {0};
};

T5Net &instance() {
  static T5Net n;
  return n;
}

}  // namespace

hal::Net *make_net() { return &instance(); }

}  // namespace t5pro
}  // namespace quire
